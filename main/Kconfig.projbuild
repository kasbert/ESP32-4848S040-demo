## main/Kconfig.projbuild
```kconfig
menu "Example Configuration"
    config EXAMPLE_DOUBLE_FB
        bool "Use double Frame Buffer"
        default "y"
        help
            Enable this option, driver will allocate two frame buffers.
    config EXAMPLE_LCD_H_RES
        int "Horizontal resolution"
        default 480
    config EXAMPLE_LCD_V_RES
        int "Vertical resolution"
        default 480
    config EXAMPLE_LCD_BIT_PER_PIXEL
        int "Bits per pixel"
        default 16
    config EXAMPLE_RGB_BIT_PER_PIXEL
        int "RGB Bits per pixel"
        default 16
    config EXAMPLE_RGB_DATA_WIDTH
        int "RGB data width"
        default 16
    menu "LCD SPI IO"
        config EXAMPLE_LCD_IO_SPI_CS
            int "LCD SPI CS PIN"
            default 39
        config EXAMPLE_LCD_IO_SPI_SCL
            int "LCD SPI SCL PIN"
            default 48
        config EXAMPLE_LCD_IO_SPI_SDA
            int "LCD SPI SDA PIN"
            default 47
        config EXAMPLE_LCD_IO_RST
            int "LCD SPI CS PIN"
            default -1
    endmenu
    menu "LCD RGB Timings"
        config EXAMPLE_LCD_PIXEL_CLOCK_HZ
            int "PIXEL_CLOCK_HZ"
            default 9000000
        config EXAMPLE_LCD_H_F_PORCH
            int "H_F_PORCH"
            default 10
        config EXAMPLE_LCD_H_P_WIDTH
            int "H_P_WIDTH"
            default 8
        config EXAMPLE_LCD_H_B_PORCH
            int "H_B_PORCH"
            default 50
        config EXAMPLE_LCD_V_F_PORCH
            int "H_F_PORCH"
            default 10
        config EXAMPLE_LCD_V_P_WIDTH
            int "H_P_WIDTH"
            default 8
        config EXAMPLE_LCD_V_B_PORCH
            int "H_B_PORCH"
            default 20
    endmenu
    menu "RGB IO"
        config EXAMPLE_LCD_IO_RGB_DISP
            int "IO_RGB_DISP"
            default -1
        config EXAMPLE_LCD_IO_RGB_DISP
            int "IO_RGB_DISP"
            default -1
        config EXAMPLE_LCD_IO_RGB_VSYNC
            int "IO_RGB_VSYNC"
            default 17
        config EXAMPLE_LCD_IO_RGB_HSYNC
            int "IO_RGB_HSYNC"
            default 16
        config EXAMPLE_LCD_IO_RGB_DE
            int "IO_RGB_DE"
            default 18
        config EXAMPLE_LCD_IO_RGB_PCLK
            int "IO_RGB_PCLK"
            default 21
        config EXAMPLE_LCD_IO_RGB_DATA0
            int "IO_RGB_DATA0"
            default 11
        config EXAMPLE_LCD_IO_RGB_DATA1
            int "IO_RGB_DATA1"
            default 12
        config EXAMPLE_LCD_IO_RGB_DATA2
            int "IO_RGB_DATA2"
            default 13
        config EXAMPLE_LCD_IO_RGB_DATA3
            int "IO_RGB_DATA3"
            default 14
        config EXAMPLE_LCD_IO_RGB_DATA4
            int "IO_RGB_DATA4"
            default 0
        config EXAMPLE_LCD_IO_RGB_DATA5
            int "IO_RGB_DATA5"
            default 8
        config EXAMPLE_LCD_IO_RGB_DATA6
            int "IO_RGB_DATA6"
            default 20
        config EXAMPLE_LCD_IO_RGB_DATA7
            int "IO_RGB_DATA7"
            default 3
        config EXAMPLE_LCD_IO_RGB_DATA8
            int "IO_RGB_DATA8"
            default 46
        config EXAMPLE_LCD_IO_RGB_DATA9
            int "IO_RGB_DATA9"
            default 9
        config EXAMPLE_LCD_IO_RGB_DATA10
            int "IO_RGB_DATA10"
            default 10
        config EXAMPLE_LCD_IO_RGB_DATA11
            int "IO_RGB_DATA11"
            default 4
        config EXAMPLE_LCD_IO_RGB_DATA12
            int "IO_RGB_DATA12"
            default 5
        config EXAMPLE_LCD_IO_RGB_DATA13
            int "IO_RGB_DATA13"
            default 6
        config EXAMPLE_LCD_IO_RGB_DATA14
            int "IO_RGB_DATA14"
            default 7
        config EXAMPLE_LCD_IO_RGB_DATA15
            int "IO_RGB_DATA15"
            default 15
    endmenu
    config EXAMPLE_LCD_BK_LIGHT_PIN
        int "BK_LIGHT_PIN"
        default 38
    config EXAMPLE_LCD_BK_LIGHT_ON_LEVEL
        int "BK_LIGHT_ON_LEVEL"
        default 1
    menu "Touchpad IO"
        config EXAMPLE_TOUCH_I2C_NUM
            int "I2C_NUM"
            default 0
        config EXAMPLE_TOUCH_I2C_CLK_HZ
            int "I2C_CLK_HZ"
            default 400000
        config EXAMPLE_TOUCH_I2C_SDA
            int "I2C_SDA"
            default 19
        config EXAMPLE_TOUCH_I2C_SCL
            int "I2C_SCL"
            default 45
        config EXAMPLE_TOUCH_GPIO_INT
            int "GPIO_INT"
            default -1
        config EXAMPLE_TOUCH_GPIO_RST
            int "GPIO_RST"
            default -1
    endmenu
endmenu
```
